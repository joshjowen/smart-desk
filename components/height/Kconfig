## components/height/Kconfig
```kconfig
menu "Desk height sensor"

    config DESK_HEIGHT_BUDGET_MS
        int "VL53L0X timing budget, default profile (ms)"
        range 20 500
        default 50
        help
            About one sample per budget (50 ms = ~20 Hz).

    config DESK_HEIGHT_BUDGET_ACCURATE_MS
        int "VL53L0X timing budget, high-accuracy profile (ms)"
        range 20 500
        default 200

    config DESK_HEIGHT_EMA_PCT
        int "Default filter EMA alpha (percent)"
        range 5 100
        default 30

endmenu
```

## components/motion/Kconfig
```kconfig
menu "Desk motion"

    config DESK_SIMULATOR
        bool "Simulated desk (opto outputs stay off)"
        default n
        help
            Motion drives a simulated desk instead of the opto outputs, for
            desk-free development. The outputs are still forced off at boot.

    config DESK_OPTO_ACTIVE_LOW
        bool "Opto inputs are active-low (sink mode)"
        default n
        help
            n: source mode, GPIO -> module IN (I1/I2), GPIO high = button pressed.
            y: sink mode, 5 V -> IN+, GPIO -> IN-, GPIO low = button pressed.

    config DESK_OPTO_UP_GPIO
        int "Opto UP GPIO"
        default 3

    config DESK_OPTO_DOWN_GPIO
        int "Opto DOWN GPIO"
        default 7

    config DESK_HANDSET_SENSE
        bool "Sense physical handset presses"
        default n
        help
            Reads the handset UP/DOWN lines (through a divider or opto) as inputs.
            A press during an automatic move stops it.

    config DESK_HANDSET_UP_GPIO
        int "Handset sense UP GPIO"
        depends on DESK_HANDSET_SENSE
        default 17

    config DESK_HANDSET_DOWN_GPIO
        int "Handset sense DOWN GPIO"
        depends on DESK_HANDSET_SENSE
        default -1
        help
            -1 = not connected.

    config DESK_HANDSET_ACTIVE_LOW
        bool "Handset sense inputs read low when pressed"
        depends on DESK_HANDSET_SENSE
        default y

    config DESK_SIM_SPEED_MM_S
        int "Simulated speed (mm/s)"
        depends on DESK_SIMULATOR
        default 25

    config DESK_SIM_MIN_MM
        int "Simulated lowest height (mm)"
        depends on DESK_SIMULATOR
        default 650

    config DESK_SIM_MAX_MM
        int "Simulated highest height (mm)"
        depends on DESK_SIMULATOR
        default 1150

    config DESK_SIM_START_MM
        int "Simulated height at boot (mm)"
        depends on DESK_SIMULATOR
        default 720

    config DESK_PRESET_SIT_MM
        int "Default Sit preset (mm)"
        default 720

    config DESK_PRESET_STAND_MM
        int "Default Stand preset (mm)"
        default 1100

    config DESK_SEEK_TOLERANCE_MM
        int "Seek tolerance (+/- mm)"
        default 8

    config DESK_MAX_MOVE_S_UNCAL
        int "Max single move time before calibration (s)"
        default 25

    config DESK_DUTY_WINDOW_S
        int "Duty-cycle rolling window (s)"
        range 120 3600
        default 1200

    config DESK_DUTY_MAX_ON_S
        int "Max motor-on time per window (s)"
        range 10 600
        default 120
        help
            Shorten (with the window) to test the cooldown path.

    config DESK_CAL_MOTOR_S
        int "Motor time the calibration routine needs (s)"
        range 30 115
        default 90
        help
            Calibration only starts with at least this much duty budget left.
            Worst case on a desk with ~31 s full travel is ~75 s.

    config DESK_DEBUG_COMMANDS
        bool "Debug console commands (fault/duty injection, crash)"
        default y

endmenu
```

## components/ui/Kconfig
```kconfig
menu "Desk UI"

    config DESK_UI_UNITS_CM
        bool "Show height in cm (otherwise mm)"
        default n

    config DESK_UI_AUTOLOCK_S
        int "Auto-lock after no touch (s)"
        range 5 600
        default 30

    config DESK_UI_DIM_S
        int "Dim backlight after locked for (s)"
        range 5 3600
        default 60

    config DESK_UI_BACKLIGHT
        int "Backlight level (%)"
        range 5 100
        default 80

    config DESK_UI_BACKLIGHT_DIM
        int "Dimmed backlight level (%)"
        range 0 50
        default 3

endmenu
```

## main/Kconfig.projbuild
```kconfig
menu "Desk app"

    config DESK_OTA_VALID_AFTER_S
        int "Mark new firmware valid after running this long (s)"
        default 30
        help
            After an OTA update the new image is on probation. If it resets
            before this time, the bootloader rolls back to the previous image.

    config DESK_DEBUG_BOOT_CRASH
        bool "Debug: crash 5 s after boot (build a deliberately bad OTA image)"
        default n

endmenu
```

## sdkconfig.defaults
```kconfig
CONFIG_IDF_TARGET="esp32c6"

# Flash / partitions
CONFIG_ESPTOOLPY_FLASHSIZE_8MB=y
CONFIG_PARTITION_TABLE_CUSTOM=y
CONFIG_PARTITION_TABLE_CUSTOM_FILENAME="partitions.csv"
CONFIG_COMPILER_OPTIMIZATION_SIZE=y

# Console on the built-in USB Serial/JTAG
CONFIG_ESP_CONSOLE_USB_SERIAL_JTAG=y

# Watchdogs: task watchdog panics so a hung motion task resets the chip
CONFIG_ESP_TASK_WDT_EN=y
CONFIG_ESP_TASK_WDT_PANIC=y
CONFIG_ESP_TASK_WDT_TIMEOUT_S=2

CONFIG_FREERTOS_HZ=1000

# LVGL 9
CONFIG_LV_COLOR_DEPTH_16=y
CONFIG_LV_USE_CLIB_MALLOC=y
CONFIG_LV_USE_CLIB_STRING=y
CONFIG_LV_USE_CLIB_SPRINTF=y
CONFIG_LV_DEF_REFR_PERIOD=16
CONFIG_LV_FONT_MONTSERRAT_14=y
CONFIG_LV_FONT_MONTSERRAT_20=y
CONFIG_LV_FONT_MONTSERRAT_28=y
CONFIG_LV_FONT_MONTSERRAT_48=y
CONFIG_LV_FONT_DEFAULT_MONTSERRAT_14=y
CONFIG_LV_USE_OBSERVER=n
CONFIG_LV_BUILD_EXAMPLES=n

CONFIG_LV_THEME_DEFAULT_DARK=y
```
